#include "SSD1306AsciiAvrI2c.h"  // библиотека дисплея
#include "utf8font10x16.h"       // шрифт
#define I2C_ADDRESS 0x3C         // инициализация дисплея
SSD1306AsciiAvrI2c oled;         // называем дисплей для кода

#define rel 7   // называем выход на реле
#define sel 9   // называем вход на кнопку выбора режима
#define pot A0  // называем вход потенциометра для выбора время

int SEC = 0;          // задаём переменные время для кода
int MIN = 0;          // задаём переменные время для кода
unsigned long timer;  // задаём переменные время для кода

byte w = 0;  // задаём переменную цикла для кода

void setup() {
  oled.begin(&Adafruit128x64, I2C_ADDRESS);  // инициализация дисплея
  oled.setFont(utf8font10x16);               // инициализация шрифта

  pinMode(rel, OUTPUT);     // определяем каким будет пин
  digitalWrite(rel, HIGH);  // определяем начальное состояние пина

  pinMode(pot, INPUT);         // определяем каким будет пин
  pinMode(sel, INPUT_PULLUP);  // определяем каким будет пин
}

void loop() {
  int x;  // определяем переменную время для корректного отображения при нуливом положении
  int y;  // определяем переменную время для корректного отображения при положении больше нуля

  x = analogRead(pot) / 60;  // делим переменную для получения нужного диапазона(1-18 минут при 60)
  y = x + 1;                 // определяем переменную время для корректного отображения при положении больше нуля
  MIN = y;                   // передаём переменную время в дальнейший код


  oled.clear();            // очищаем дисплей
  oled.set2X();            // увеличиваем шрифт в 2 раза
  oled.setCursor(18, 0);   // выставляем курсор
  oled.print("SET TIME");  // выводим на дисплей
  oled.setCursor(35, 3);   // выставляем курсор
  oled.print(y);           // выводим на дисплей
  oled.setCursor(60, 3);   // выставляем курсор
  oled.print("min");       // выводим на дисплей
  delay(500);

  if (x == 0) {  // передаём переменную время в дальнейший код если потенциометр в нуливом положении
    MIN = x;     // передаём переменную время в дальнейший код если потенциометр в нуливом положении
  }
  if (!digitalRead(sel)) {  // ждём нажатие кнопки для начала отсчёта

    if (SEC == 0) {   // магия с таймером
      SEC = 60;       // магия с таймером
      MIN = MIN - 1;  // магия с таймером
    }
    if (MIN < 0) { MIN = 0; }  // магия с таймером
    w = 1;
  }

  while (w == 1) {
    if (millis() - timer > 1000) {  // переводим в секунды
      timer = millis();
      SEC = SEC - 1;
      if (SEC == 0 && MIN == 0) {  // если таймер дошел до 0
        oled.clear();              // очищаем дисплей
        oled.setCursor(40, 3);     // выставляем курсор
        oled.print("STOP");        // выводим на дисплей
        digitalWrite(rel, LOW);    // переводим выход на реле в положение 0
        w = 0;                     // выходим из цикла
        exit(0);                   // останавливаем ардуино
      }

      if (SEC == 0 && w == 1) {    // магия с таймером
        SEC = 59;                  // магия с таймером
        MIN = MIN - 1;             // магия с таймером
        if (MIN < 0) { MIN = 0; }  // магия с таймером
      }

      if (w == 1) {             // пока работает таймер выводим на дисплей
        oled.clear();           // очищаем дисплей
        oled.set2X();           // увеличиваем шрифт в 2 раза
        oled.setCursor(35, 0);  // выставляем курсор
        oled.print(y);          // выводим на дисплей
        oled.setCursor(60, 0);  // выставляем курсор
        oled.print("min");      // выводим на дисплей
        oled.setCursor(35, 3);  // выставляем курсор
        oled.print(MIN);        // выводим на дисплей
        oled.print(" : ");      // выводим на дисплей
        oled.print(SEC);        // выводим на дисплей
      }
    }
  }
}